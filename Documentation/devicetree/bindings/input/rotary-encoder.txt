## Documentation/devicetree/bindings/input/rotary-encoder.txt
```
Rotary encoder DT bindings

Required properties:
- gpios: a spec for at least two GPIOs to be used, most significant first

Optional properties:
- linux,axis: the input subsystem axis to map to this rotary encoder.
  Defaults to 0 (ABS_X / REL_X)
- rotary-encoder,noaxis: Report e.g. key events instead of axis events.
  Event codes must be specified by code-cw and code-ccw and the event
  type by linux,event-type.
- rotary-encoder,steps: Number of steps in a full turnaround of the
  encoder. Only relevant for absolute axis. Defaults to 24 which is a
  typical value for such devices.
- rotary-encoder,relative-axis: register a relative axis rather than an
  absolute one. Relative axis will only generate +1/-1 events on the input
  device, hence no steps need to be passed.
- rotary-encoder,rollover: Automatic rollover when the rotary value becomes
  greater than the specified steps or smaller than 0. For absolute axis only.
- rotary-encoder,steps-per-period: Number of steps (stable states) per period.
  The values have the following meaning:
  1: Full-period mode (default)
  2: Half-period mode
  4: Quarter-period mode
- wakeup-source: Boolean, rotary encoder can wake up the system.
- rotary-encoder,encoding: String, the method used to encode steps.
  Supported are "gray" (the default and more common) and "binary".
- linux,code-cw: Event code emitted for every step clockwise.
- linux,code-ccw: Event code emitted on counter clockwise rotation per step.
- linux,event-type: Event type for code-cw and code-ccw.
  Defaults to (KEY_EV)

Deprecated properties:
- rotary-encoder,half-period: Makes the driver work on half-period mode.
  This property is deprecated. Instead, a 'steps-per-period ' value should
  be used, such as "rotary-encoder,steps-per-period = <2>".

See Documentation/input/devices/rotary-encoder.rst for more information.

Example:

		rotary@0 {
			compatible = "rotary-encoder";
			gpios = <&gpio 19 1>, <&gpio 20 0>; /* GPIO19 is inverted */
			linux,axis = <0>; /* REL_X */
			rotary-encoder,encoding = "gray";
			rotary-encoder,relative-axis;
		};

		rotary@1 {
			compatible = "rotary-encoder";
			gpios = <&gpio 21 0>, <&gpio 22 0>;
			linux,axis = <1>; /* ABS_Y */
			rotary-encoder,steps = <24>;
			rotary-encoder,encoding = "binary";
			rotary-encoder,rollover;
		};

		rotary@2 {
			compatible = "rotary-encoder";
			gpios = <&gpio5 30 0>, <&gpio5 31 0>;
			rotary-encoder,noaxis;
			linux,code-cw = <103>; /* DOWN */
			linux,code-ccw = <108>; /* UP */
			linux,event-type = <KEY_EV>;
		};
```

## Documentation/devicetree/bindings/leds/backlight/pwm-backlight.txt
```
pwm-backlight bindings

Required properties:
  - compatible: "pwm-backlight"
  - pwms: OF device-tree PWM specification (see PWM binding[0])
  - power-supply: regulator for supply voltage

Optional properties:
  - pwm-names: a list of names for the PWM devices specified in the
               "pwms" property (see PWM binding[0])
  - enable-display-gpios: contains a single GPIO specifier for the GPIO which
                          enables and disables the display logic.
                          (see GPIO binding[1])
  - enable-backlight-gpios: contains a single GPIO specifier for the GPIO which
                            enables and disables the backlight.
                            (see also GPIO binding[1])
  - pwm-on-delay-ms: Delay in ms between enabling the display using the
                     enable-display-gpio and setting an initial (non-zero) PWM
                     (and activating the enable-backlight-gpio at the same
                     time).
  - pwm-off-delay-ms: Delay in ms between disabling the backlight using GPIO
                      (and setting PWM value to 0 at the same time) and
                      switching off the enable-display-gpio.
  - brightness-levels: Array of distinct brightness levels. Typically these
                       are in the range from 0 to 255, but any range starting at
                       0 will do. The actual brightness level (PWM duty cycle)
                       will be interpolated from these values. 0 means a 0% duty
                       cycle (darkest/off), while the last value in the array
                       represents a 100% duty cycle (brightest).
  - default-brightness-level: The default brightness level (index into the
                              array defined by the "brightness-levels" property).
  - num-interpolated-steps: Number of interpolated steps between each value
                            of brightness-levels table. This way a high
                            resolution pwm duty cycle can be used without
                            having to list out every possible value in the
                            brightness-level array.

[0]: Documentation/devicetree/bindings/pwm/pwm.txt
[1]: Documentation/devicetree/bindings/gpio/gpio.txt

Example:

	backlight {
		compatible = "pwm-backlight";
		pwms = <&pwm 0 5000000>;

		brightness-levels = <0 4 8 16 32 64 128 255>;
		default-brightness-level = <6>;

		power-supply = <&vdd_bl_reg>;
		enable-display-gpios = <&gpio 58 0>;
		enable-backlight-gpios = <&gpio 60 0>;
		post-pwm-on-delay-ms = <10>;
		pwm-off-delay-ms = <10>;
	};

Example using num-interpolation-steps:

	backlight {
		compatible = "pwm-backlight";
		pwms = <&pwm 0 5000000>;

		brightness-levels = <0 2048 4096 8192 16384 65535>;
		num-interpolated-steps = <2048>;
		default-brightness-level = <4096>;

		power-supply = <&vdd_bl_reg>;
		enable-display-gpios = <&gpio 58 0>;
	};
```
