// SPDX-License-Identifier: GPL-2.0
/*
 * Copyright (C) 2018-2020 Christ Electronic Systems GmbH
 * Peter Fink <pfink@christ-es.de>
 * Copyright (C) 2013-2015 Freescale Semiconductor, Inc.
 *
 * This program is free software; you can redistribute it and/or modify
 * it under the terms of the GNU General Public License version 2 as
 * published by the Free Software Foundation.
 */

/dts-v1/;

#include "imx6dl.dtsi"
#include "imx6qdl-blix-bx.dtsi"

/ {
	model = "Christ i.MX6 DualLite BLIX-BDLX00";
	compatible = "ces,imx6dl-blix-bdlx", "fsl,imx6dl";
};
