/*
 * Copyright (C) 2017 Christ Electronic Systems GmbH
 * Peter Fink <pfink@christ-es.de>
 * Copyright (C) 2013-2015 Freescale Semiconductor, Inc.
 *
 * This program is free software; you can redistribute it and/or modify
 * it under the terms of the GNU General Public License version 2 as
 * published by the Free Software Foundation.
 */

/dts-v1/;

#include "imx6dl.dtsi"
#include "imx6qdl-pixi-cx.dtsi"

/ {
	model = "Christ i.MX6 DualLite PIXI Board 2GB RAM";
	compatible = "ces,imx6dl-pixi-cdlx", "fsl,imx6dl";
};

&ldb {
	lvds-channel@0 {
		crtc = "ipu1-di0";
	};

	lvds-channel@1 {
		crtc = "ipu1-di1";
	};
};
