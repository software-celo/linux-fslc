// SPDX-License-Identifier: GPL-2.0
/*
 * Copyright (C) 2018-2020 Christ Electronic Systems GmbH
 * Peter Fink <pfink@christ-es.de>
 * Copyright 2012-2015 Freescale Semiconductor, Inc.
 * Copyright 2011 Linaro Ltd.
 *
 * The code contained herein is licensed under the GNU General Public
 * License. You may obtain a copy of the GNU General Public License
 * Version 2 or later at the following locations:
 *
 * http://www.opensource.org/licenses/gpl-license.html
 * http://www.gnu.org/copyleft/gpl.html
 */

/dts-v1/;

#include "imx6dl.dtsi"
#include "imx6qdl-medix-x.dtsi"

/ {
	model = "Christ i.MX6 Dual Lite MEDIX-TDLX00";
	compatible = "ces,imx6dl-medix-tdlx", "fsl,imx6dl";
};

&clks {
        assigned-clocks = <&clks IMX6QDL_CLK_LDB_DI0_SEL>,
                          <&clks IMX6QDL_CLK_LDB_DI1_SEL>;
        assigned-clock-parents = <&clks IMX6QDL_CLK_PLL5_VIDEO>,
                                 <&clks IMX6QDL_CLK_PLL5_VIDEO>;
};

&hdmi {
	status = "disabled";
};

&i2c2 {
	status = "disabled";
};
